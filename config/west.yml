## config/west.yml
```yaml
manifest:
  remotes:
    - name: zmkfirmware
      url-base: https://github.com/zmkfirmware
    - name: cormoran
      url-base: https://github.com/cormoran
    - name: kbrd-space
      url-base: https://github.com/kbrd-space
    - name: dhruvinsh
      url-base: https://github.com/dhruvinsh
  projects:
    - name: eyelash_corne
      url: https://github.com/a741725193/zmk-new_corne
      revision: main
#    - name: zmk
#      remote: zmkfirmware
#      revision: v0.3
#      import: app/west.yml
    - name: zmk
      remote: cormoran
      revision: v0.3-branch+dya
      import: app/west.yml
    - name: zmk-behavior-runtime-sensor-rotate
      remote: cormoran
      revision: main
    - name: zmk-module-ble-management
      remote: cormoran
      revision: zmk-v0.3.0.0
    - name: zmk-module-battery-history
      remote: cormoran
      revision: main
    - name: zmk-module-settings-rpc
      remote: cormoran
      revision: main
    - name: zmk-module-runtime-input-processor
      remote: cormoran
      revision: zmk-v0.3.0.0
    - name: zmk-anti-idle
      remote: kbrd-space
      revision: main
    - name: zmk-tri-state
      remote: dhruvinsh
      revision: main
  self:
    path: config
```
